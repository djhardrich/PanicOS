## Config.in
```kconfig
source "$BR2_EXTERNAL_PANICOS_PATH/kconfig/Config.in"
source "$BR2_EXTERNAL_PANICOS_PATH/package/Config.in"
```

## board/anbernic/rg353p/Config.in
```kconfig
config PANICOS_DEVICE_RG353P
	bool "anbernic/rg353p (Rockchip RK3566)"
	select PANICOS_SOC_ROCKCHIP_RK3566
	help
	  Anbernic RG353P — Rockchip RK3566 (quad-core Cortex-A55), 1 GB LPDDR4.
	  Uses the anbernic-rgxx3-rk3566 U-Boot defconfig (auto-detects device
	  via DTSOC at runtime, covers the whole RGxx3 Anbernic family).

	  Kernel: Linux 7.0.1 mainline + ROCKNIX patches.
	  Default DTB: rk3566-anbernic-rg353p.dtb (in-tree upstream).
```

## board/anbernic/rg35xx-pro-lpddr3/Config.in
```kconfig
config PANICOS_DEVICE_RG35XX_PRO_LPDDR3
	bool "anbernic/rg35xx-pro-lpddr3 (Allwinner H700, LPDDR3 variant)"
	select PANICOS_SOC_ALLWINNER_H700
	help
	  Anbernic RG35XX Pro — LPDDR3 DRAM variant (less common; some
	  early or budget units). U-Boot uses
	  anbernic_rg35xx_h700_lpddr3_defconfig with DCDC3 = 1200 mV and
	  LPDDR3-specific DRAM timings.

	  For the more common LPDDR4 retail variant, build the
	  "rg35xx-pro" target instead. Flashing the wrong DRAM-variant
	  image WILL cause boot failure — they share kernel, DTBs, and
	  rootfs but the U-Boot SPL is built differently.

	  Kernel: Linux 7.0.1 mainline + ROCKNIX patches.
```

## board/anbernic/rg35xx-pro/Config.in
```kconfig
config PANICOS_DEVICE_RG35XX_PRO
	bool "anbernic/rg35xx-pro (Allwinner H700, LPDDR4)"
	select PANICOS_SOC_ALLWINNER_H700
	help
	  Anbernic RG35XX Pro — LPDDR4 DRAM variant (most common retail
	  hardware). U-Boot uses anbernic_rg35xx_h700_lpddr4_defconfig
	  with DCDC3 = 1100 mV.

	  If your hardware is the less-common LPDDR3 variant, build the
	  "rg35xx-pro-lpddr3" target instead — the U-Boot DRAM init
	  parameters and DCDC3 voltage differ between the two and a
	  mismatch will cause boot failure or instability.

	  Kernel: Linux 7.0.1 mainline + ROCKNIX patches.
```

## board/anbernic/rk3326-a/Config.in
```kconfig
config PANICOS_DEVICE_RK3326_A
	bool "anbernic/rk3326-a (Rockchip RK3326 — legacy variant)"
	select PANICOS_SOC_ROCKCHIP_RK3326
	help
	  RK3326 devices originally shipped with hardkernel U-Boot (a-variant):
	    OGA, OGS (ODROID-GO Super), RG351M, RG351V, GameConsole R33S,
	    MagicX XU10, GameForce Chi.
	  Uses mainline U-Boot v2025.10 (which fully supports these SoCs by now)
	  with a_boot.scr for ADC-based DTB selection at runtime.

	  Kernel: Linux 6.12 LTS + ROCKNIX patches.
```

## board/anbernic/rk3326-b/Config.in
```kconfig
config PANICOS_DEVICE_RK3326_B
	bool "anbernic/rk3326-b (Rockchip RK3326 — mainline variant)"
	select PANICOS_SOC_ROCKCHIP_RK3326
	help
	  RK3326 devices using mainline U-Boot v2025.10 (b-variant):
	    Powkiddy RGB10X, MagicX XU-Mini-M, EEClone (GameConsole EEClone).
	  ADC-based DTB selection at runtime via b_boot.scr.

	  Kernel: Linux 6.12 LTS + ROCKNIX patches.
```

## board/magicx/magicx-zero-28/Config.in
```kconfig
config PANICOS_DEVICE_MAGICX_ZERO_28
	bool "magicx/zero-28 (Allwinner A133)"
	select PANICOS_SOC_ALLWINNER_A133
	help
	  MagicX Zero 28 — Allwinner A133 (quad-core Cortex-A53).
	  All kernel and bootloader components are pre-built blobs from the
	  vendor BSP. Build mode: blob-staging (no kernel/U-Boot compile).
```

## board/panicos/harness-smoke/Config.in
```kconfig
config PANICOS_DEVICE_HARNESS_SMOKE
	bool "harness-smoke (generic ARM64, no real device)"
	help
	  Pseudo-device used to smoke-test the PanicOS build harness.
	  Builds a generic AArch64 rootfs with BusyBox. Not flashable
	  to any real hardware.
```

## board/powkiddy/powkiddy-v20/Config.in
```kconfig
config PANICOS_DEVICE_POWKIDDY_V20
	bool "powkiddy/v20 (Allwinner A133)"
	select PANICOS_SOC_ALLWINNER_A133
	help
	  Powkiddy V20 — Allwinner A133 (quad-core Cortex-A53).
	  All kernel and bootloader components are pre-built blobs from the
	  vendor BSP. Build mode: blob-staging (no kernel/U-Boot compile).
```

## board/powkiddy/powkiddy-v90s/Config.in
```kconfig
config PANICOS_DEVICE_POWKIDDY_V90S
	bool "powkiddy/v90s (Allwinner A133)"
	select PANICOS_SOC_ALLWINNER_A133
	help
	  Powkiddy V90s — Allwinner A133 (quad-core Cortex-A53).
	  All kernel and bootloader components are pre-built blobs from the
	  vendor BSP. Build mode: blob-staging (no kernel/U-Boot compile).
	  Note: V90s ships a different kernel binary than V20 despite sharing
	  the same SoC and partition layout.
```

## board/trimui/trimui-brick/Config.in
```kconfig
config PANICOS_DEVICE_TRIMUI_BRICK
	bool "trimui/brick (Allwinner A133)"
	select PANICOS_SOC_ALLWINNER_A133
	help
	  TrimUI Brick — Allwinner A133 (quad-core Cortex-A53), 1 GB LPDDR4.
	  All kernel and bootloader components are pre-built blobs from the
	  TrimUI vendor BSP. Build mode: blob-staging (no kernel/U-Boot compile).
```

## board/trimui/trimui-smart-pro/Config.in
```kconfig
config PANICOS_DEVICE_TRIMUI_SMART_PRO
	bool "trimui/smart-pro (Allwinner A133)"
	select PANICOS_SOC_ALLWINNER_A133
	help
	  TrimUI Smart Pro — Allwinner A133 (quad-core Cortex-A53).
	  All kernel and bootloader components are pre-built blobs from the
	  TrimUI vendor BSP. Build mode: blob-staging (no kernel/U-Boot compile).
```

## flavors/launcher/Config.in
```kconfig
config PANICOS_FLAVOR_LAUNCHER
	bool "launcher — EmulationStation + PortMaster + Tailscale + WireGuard"
	depends on PANICOS_SOC_ALLWINNER_H700 || PANICOS_SOC_ROCKCHIP_RK3566
	help
	  ROCKNIX-style frontend with VPN tools, but no built-in
	  emulators. EmulationStation is the launcher; PortMaster
	  installs on demand from the Tools menu (no 100MB+ bundled in
	  the image); tailscale and wireguard-tools cover the VPN side.

	  Use this when you want a familiar handheld UI/UX that you can
	  add your own ports to without inheriting ROCKNIX's full retro
	  stack (RetroArch + 30+ standalone emulators).

	  Pulls in mesa3d/panfrost (same as pht), plus boost + freeimage
	  + vlc + the rest of the ES dep tree. First build is heavy
	  (60+ min on a cold cache); incremental edits are fast.
```

## flavors/minimal/Config.in
```kconfig
config PANICOS_FLAVOR_MINIMAL
	bool "minimal — BusyBox only, useful for bring-up"
	help
	  Smallest possible userspace. BusyBox + init. No X, no Wayland,
	  no extra packages. Used for new-device bring-up and the build
	  harness smoke test.
```

## flavors/pht/Config.in
```kconfig
config PANICOS_FLAVOR_PHT
	bool "pht — ProHandheldTracker (audio-tracker, RT scheduling)"
	depends on PANICOS_SOC_ALLWINNER_H700 || PANICOS_SOC_ROCKCHIP_RK3566
	help
	  Boots straight into ProHandheldTracker with RT scheduling
	  (chrt -f 50). Replaces the tty1 getty so PHT owns the panel
	  via KMSDRM. Requires the panicos-pht payload to be vendored at
	  vendor/pht/ (run scripts/vendor-pht.sh once before building).

	  No login prompt by default — drop into a shell via SSH if you
	  need to poke around. Wifi auto-connect from /boot/panicos-wifi.cfg
	  works exactly like in the minimal flavor.

	  aarch64-only (the pht binary).
```

## kconfig/Config.in
```kconfig
menu "PanicOS"

source "$BR2_EXTERNAL_PANICOS_PATH/kconfig/devices.in"
source "$BR2_EXTERNAL_PANICOS_PATH/kconfig/socs.in"
source "$BR2_EXTERNAL_PANICOS_PATH/kconfig/flavors.in"
source "$BR2_EXTERNAL_PANICOS_PATH/kconfig/sizes.in"

endmenu
```

## package/Config.in
```kconfig
menu "PanicOS packages"

source "$BR2_EXTERNAL_PANICOS_PATH/package/panicos-firstboot/Config.in"
source "$BR2_EXTERNAL_PANICOS_PATH/package/panicos-sshkeys/Config.in"
source "$BR2_EXTERNAL_PANICOS_PATH/package/panicos-autologin/Config.in"
source "$BR2_EXTERNAL_PANICOS_PATH/package/panicos-wifi-config/Config.in"
source "$BR2_EXTERNAL_PANICOS_PATH/package/panicos-bootdiag/Config.in"
source "$BR2_EXTERNAL_PANICOS_PATH/package/panicos-pht/Config.in"
source "$BR2_EXTERNAL_PANICOS_PATH/package/rocknix-joypad/Config.in"
source "$BR2_EXTERNAL_PANICOS_PATH/package/panicos-splash/Config.in"
source "$BR2_EXTERNAL_PANICOS_PATH/package/panicos-emulationstation/Config.in"
source "$BR2_EXTERNAL_PANICOS_PATH/package/panicos-es-theme-art-book-next/Config.in"
source "$BR2_EXTERNAL_PANICOS_PATH/package/panicos-es-theme/Config.in"
source "$BR2_EXTERNAL_PANICOS_PATH/package/panicos-launcher-tools/Config.in"
source "$BR2_EXTERNAL_PANICOS_PATH/package/panicos-portmaster-preload/Config.in"
source "$BR2_EXTERNAL_PANICOS_PATH/package/panicos-pht-portmaster/Config.in"
source "$BR2_EXTERNAL_PANICOS_PATH/package/panicos-net-tools/Config.in"
source "$BR2_EXTERNAL_PANICOS_PATH/package/panicos-sway/Config.in"
source "$BR2_EXTERNAL_PANICOS_PATH/package/panicos-input-sense/Config.in"
source "$BR2_EXTERNAL_PANICOS_PATH/package/panicos-quirks/Config.in"
source "$BR2_EXTERNAL_PANICOS_PATH/package/networkmanager/Config.in"
source "$BR2_EXTERNAL_PANICOS_PATH/package/panicos-libfreeimage/Config.in"
source "$BR2_EXTERNAL_PANICOS_PATH/package/python-dbussy/Config.in"
source "$BR2_EXTERNAL_PANICOS_PATH/package/panicos-samba/Config.in"
source "$BR2_EXTERNAL_PANICOS_PATH/package/panicos-copyparty/Config.in"
source "$BR2_EXTERNAL_PANICOS_PATH/package/panicos-umtprd/Config.in"
source "$BR2_EXTERNAL_PANICOS_PATH/package/panicos-ffmpeg4-compat/Config.in"
source "$BR2_EXTERNAL_PANICOS_PATH/package/panicos-box64/Config.in"
source "$BR2_EXTERNAL_PANICOS_PATH/package/panicos-box86/Config.in"
source "$BR2_EXTERNAL_PANICOS_PATH/package/panicos-lib32/Config.in"
source "$BR2_EXTERNAL_PANICOS_PATH/package/panicos-gl4es/Config.in"
source "$BR2_EXTERNAL_PANICOS_PATH/package/panicos-libglu/Config.in"
source "$BR2_EXTERNAL_PANICOS_PATH/package/panicos-powervr-ge8300/Config.in"
source "$BR2_EXTERNAL_PANICOS_PATH/package/panicos-rtl8852bs/Config.in"
source "$BR2_EXTERNAL_PANICOS_PATH/package/supercollider/Config.in"
source "$BR2_EXTERNAL_PANICOS_PATH/package/sc3-plugins/Config.in"
source "$BR2_EXTERNAL_PANICOS_PATH/package/panicos-sc3-community-plugins/Config.in"

endmenu
```

## package/dtbocfg/Config.in
```kconfig
config BR2_PACKAGE_DTBOCFG
	bool "dtbocfg (configfs interface for runtime DT overlays)"
	depends on BR2_LINUX_KERNEL
	help
	  Out-of-tree kernel module exposing /sys/kernel/config/device-tree/
	  for loading and unloading device-tree overlays at runtime, without
	  rebuilding the base DTB or rebooting.

	  Used by ROCKNIX's panel/joypad/audio detection scripts to apply
	  hot-plug-time overlays (e.g. when SD card is moved between handhelds
	  with different ADC layouts). Required on rk3326 handhelds that ship
	  ROCKNIX-style mipi-panel.dtbo.

	  https://github.com/ikwzm/dtbocfg
```

## package/jack-example-tools/Config.in
```kconfig
config BR2_PACKAGE_JACK_EXAMPLE_TOOLS
	bool "jack-example-tools"
	depends on BR2_PACKAGE_JACK2
	help
	  JACK example / CLI tools, split out of jack2 upstream into their
	  own project. Provides jack_lsp, jack_connect, jack_disconnect,
	  jack_transport, jack_samplerate, jack_bufsize, jack_wait,
	  jack_metro, jack_load, jack_unload, jack_property, jack_evmon,
	  jack_midi_dump and friends.

	  Builds against jack2's jack.pc; at runtime they connect to
	  whatever JACK server owns the socket (on PanicOS that is PipeWire
	  via the libjack compat shim).

	  https://github.com/jackaudio/jack-example-tools
```

## package/networkmanager/Config.in
```kconfig
config BR2_PACKAGE_NETWORKMANAGER
	bool "networkmanager"
	depends on BR2_INIT_SYSTEMD
	depends on BR2_TOOLCHAIN_HAS_THREADS
	depends on BR2_USE_WCHAR
	depends on !BR2_STATIC_LIBS
	# meson + ninja host builders
	depends on BR2_PACKAGE_HOST_PYTHON3 || true
	# transitive runtime deps
	select BR2_PACKAGE_DBUS
	select BR2_PACKAGE_LIBGLIB2
	select BR2_PACKAGE_LIBNDP
	select BR2_PACKAGE_NSS
	select BR2_PACKAGE_NSPR
	select BR2_PACKAGE_UTIL_LINUX
	select BR2_PACKAGE_READLINE
	select BR2_PACKAGE_NCURSES
	select BR2_PACKAGE_IWD
	help
	  NetworkManager (1.51.4) with iwd as the Wi-Fi backend, vendored
	  from ROCKNIX (commit beb5d8a239 — "Network: Add NetworkManager
	  with iwd Wi-Fi backend"). Replaces our previous standalone-iwd +
	  manual networkd setup.

	  Buildroot 2026.02.1 doesn't ship a networkmanager package, so
	  we build it from the upstream gnome.org tarball with the same
	  meson configuration ROCKNIX uses (Wi-Fi via iwd, no
	  PolicyKit/SELinux/audit/PPP/ModemManager — the lean handheld
	  profile).

	  Why we want it: ROCKNIX's wifictl detects whether NM is active
	  and uses nmcli when it is. Steam D-Bus integration and several
	  other userspace pieces also expect NetworkManager on the system
	  bus. Sticking with raw iwd would mean reimplementing all of that
	  every time it changes upstream.
```

## package/panicos-autologin/Config.in
```kconfig
config BR2_PACKAGE_PANICOS_AUTOLOGIN
	bool "panicos-autologin (tty1)"
	depends on BR2_INIT_SYSTEMD
	help
	  Drops in /etc/systemd/system/getty@tty1.service.d/autologin.conf
	  so tty1 logs in as root automatically — no prompt. Off by default
	  (the minimal flavor wants the password prompt). Flavors that want
	  to land the user straight in a launcher (kiosk, retro frontend)
	  select this in their defconfig.fragment.
```

## package/panicos-bootdiag/Config.in
```kconfig
config BR2_PACKAGE_PANICOS_BOOTDIAG
	bool "panicos-bootdiag"
	depends on BR2_INIT_SYSTEMD
	help
	  Late-boot diagnostic dump. Runs once after multi-user.target
	  reaches active, then writes dmesg, journalctl, ip state, systemd
	  unit status, and DRM/wireless sysfs info to plain text files
	  under /boot/diag/ on the boot vfat. Pop the SD into a PC and
	  read the files to debug a board with no UART and no SSH.

	  Enable for bring-up; disable for production images. Off by default.

	  Marker file /boot/diag/done.txt is written last so you can tell
	  when it's safe to pull the SD.
```

## package/panicos-box64/Config.in
```kconfig
config BR2_PACKAGE_PANICOS_BOX64
	bool "panicos-box64"
	depends on BR2_aarch64
	select BR2_PACKAGE_HOST_CMAKE
	help
	  Box64 — x86_64 userspace emulator for aarch64.
	  Enables PortMaster to run x86_64 Linux game binaries via binfmt_misc.
```

## package/panicos-box86/Config.in
```kconfig
config BR2_PACKAGE_PANICOS_BOX86
	bool "panicos-box86"
	depends on BR2_aarch64
	help
	  Box86 — x86 (32-bit) userspace emulator for ARM.
	  Enables PortMaster to run 32-bit x86 Linux game binaries via binfmt_misc.
	  Requires panicos-lib32 for runtime armhf shared libraries.
	  Built as an armhf binary using the host arm-linux-gnueabihf cross-compiler.
```

## package/panicos-copyparty/Config.in
```kconfig
config BR2_PACKAGE_PANICOS_COPYPARTY
	bool "panicos-copyparty"
	depends on BR2_PACKAGE_PYTHON3
	depends on BR2_INIT_SYSTEMD
	help
	  Copyparty HTTP file server, serving /storage over port 3923.
	  Provides a web UI for browsing, uploading, and downloading game
	  files without needing Samba or a desktop file manager.

	  Disabled by default — enable via the ES network settings menu.
	  Ships the upstream copyparty.pyz single-file distribution.
```
