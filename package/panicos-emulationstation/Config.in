## package/panicos-emulationstation/Config.in
```kconfig
config BR2_PACKAGE_PANICOS_EMULATIONSTATION
	bool "panicos-emulationstation"
	depends on BR2_INIT_SYSTEMD
	depends on BR2_INSTALL_LIBSTDCPP
	depends on BR2_TOOLCHAIN_HAS_THREADS
	select BR2_PACKAGE_SDL2
	select BR2_PACKAGE_SDL2_MIXER
	select BR2_PACKAGE_ALSA_LIB
	select BR2_PACKAGE_FREETYPE
	select BR2_PACKAGE_LIBFREEIMAGE
	select BR2_PACKAGE_LIBCURL
	select BR2_PACKAGE_LIBCURL_OPENSSL
	select BR2_PACKAGE_OPENSSL
	select BR2_PACKAGE_RAPIDJSON
	select BR2_PACKAGE_BOOST
	select BR2_PACKAGE_BOOST_SYSTEM
	select BR2_PACKAGE_BOOST_FILESYSTEM
	select BR2_PACKAGE_BOOST_LOCALE
	select BR2_PACKAGE_BOOST_DATE_TIME
	select BR2_PACKAGE_VLC
	select BR2_PACKAGE_BASH
	select BR2_PACKAGE_FPING
	select BR2_PACKAGE_P7ZIP
	select BR2_PACKAGE_XMLSTARLET
	help
	  ROCKNIX's emulationstation-next fork — the launcher / frontend
	  used by ROCKNIX, Batocera, et al. Configured for KMSDRM
	  rendering via SDL2 + GLES2 (uses the same mesa3d/panfrost stack
	  as the pht flavor). Auto-starts on tty1 via panicos-es.service.

	  VLC is a heavy dep (~30MB in the squashfs, ~15min build cost)
	  but the upstream ES fork unconditionally `find_package(VLC
	  REQUIRED)` and patching it cleanly is more work than the build
	  cost. Pulled in for convenience; gives video previews of games
	  for free.

	  Targets the launcher flavor exclusively right now. Other flavors
	  can pull in PHT or whatever else for their own UI.
```

## package/panicos-es-theme-art-book-next/Config.in
```kconfig
config BR2_PACKAGE_PANICOS_ES_THEME_ART_BOOK_NEXT
	bool "panicos-es-theme-art-book-next"
	depends on BR2_PACKAGE_PANICOS_EMULATIONSTATION
	help
	  Anthony Caccese's "Art Book Next" theme for EmulationStation.
	  This is the same theme ROCKNIX and Knulli ship as their default,
	  pinned to the same SHA ROCKNIX uses so the look matches what
	  users coming from those distros expect.

	  Out of the box ES has no theme installed; once this package is
	  in the squashfs ES auto-picks it on first run. Switch themes
	  later in ES → UI Settings → Theme Set if you ship more than one.

	  ROCKNIX trims out a handful of subthemes (artwork-circuit,
	  -classic, -nintendont, -noir, -outline) to save space on these
	  handhelds; we mirror that trim.
```

## package/panicos-es-theme-terminus/Config.in
```kconfig
config BR2_PACKAGE_PANICOS_ES_THEME_TERMINUS
	bool "panicos-es-theme-terminus"
	help
	  Terminus: PanicOS's own monochrome terminal-style
	  EmulationStation theme. MIT licensed, bundled Noto Sans
	  Mono (SIL OFL 1.1).  Three color variants: white, phosphor
	  green, amber.
```

## package/panicos-es-theme/Config.in
```kconfig
config BR2_PACKAGE_PANICOS_ES_THEME
	bool "panicos-es-theme"
	help
	  PanicOS: PanicOS's own monochrome terminal-style
	  EmulationStation theme. MIT licensed, bundled Noto Sans
	  Mono (SIL OFL 1.1).  20 color variants including phosphor
	  green, amber, cyan, DOS blue, and more.
```

## package/panicos-ffmpeg4-compat/Config.in
```kconfig
config BR2_PACKAGE_PANICOS_FFMPEG4_COMPAT
	bool "panicos-ffmpeg4-compat"
	help
	  Provides FFmpeg 4.4.x shared libraries (libavcodec.so.58,
	  libavformat.so.58, libavutil.so.56, libswresample.so.3,
	  libswscale.so.5) for PortMaster ports that were pre-compiled
	  against FFmpeg 4.x.

	  Only the major-versioned .so files are installed; no headers or
	  binaries, so there is no conflict with the system FFmpeg (6.x).
```

## package/panicos-firstboot/Config.in
```kconfig
config BR2_PACKAGE_PANICOS_FIRSTBOOT
	bool "panicos-firstboot"
	depends on BR2_INIT_SYSTEMD
	select BR2_PACKAGE_UTIL_LINUX
	select BR2_PACKAGE_UTIL_LINUX_BINARIES   # sfdisk + standard binaries
	select BR2_PACKAGE_UTIL_LINUX_PARTX      # partx -u (fallback for partprobe)
	select BR2_PACKAGE_E2FSPROGS
	select BR2_PACKAGE_E2FSPROGS_RESIZE2FS
	help
	  PanicOS first-boot service: grows the storage partition and
	  ext4 to fill remaining free space. Self-disabling.
```

## package/panicos-gl4es/Config.in
```kconfig
config BR2_PACKAGE_PANICOS_GL4ES
	bool "panicos-gl4es"
	depends on BR2_PACKAGE_MESA3D_OPENGL_EGL
	depends on BR2_PACKAGE_SDL2
	help
	  Build gl4es (ptitSeb) as a system library.  Installs libGL.so.1 to
	  /usr/lib/ (system-wide) so PortMaster's gl_check finds it, and
	  symlinks into /usr/lib/gl4es/ for the LD_LIBRARY_PATH override in
	  libgl_PanicOS.txt.

	  Staging install provides libGL.so, GL headers (include/GL/gl.h from
	  the gl4es source tree), and a gl.pc so panicos-libglu can build
	  without going through buildroot's libgl virtual package (which
	  requires X11/GLX that we don't have).
```

## package/panicos-input-sense/Config.in
```kconfig
config BR2_PACKAGE_PANICOS_INPUT_SENSE
	bool "panicos-input-sense"
	depends on BR2_PACKAGE_BASH
	depends on BR2_PACKAGE_EVTEST
	depends on BR2_PACKAGE_PIPEWIRE && BR2_PACKAGE_WIREPLUMBER
	select BR2_PACKAGE_BASH
	select BR2_PACKAGE_EVTEST
	help
	  ROCKNIX's input_sense daemon, vendored verbatim. Listens to evdev
	  events from every input device on the system and routes special
	  keys: volume up/down (wpctl), volume mute, power button (fake
	  suspend), lid open/close, controller function-key combos
	  (brightness, screenshot, mangohud toggle, etc.).

	  We need this because handheld inputs (gpio-keys-volume,
	  axp20x-pek power button) don't route through sway by default —
	  sway-level bindsym only fires for keys that hit sway's libinput
	  pipeline. ROCKNIX's daemon reads evdev directly and side-steps
	  the WM entirely.

	  Source: third_party/rocknix/projects/ROCKNIX/packages/sysutils/
	  system-utils/sources/scripts/input_sense (and 001-functions
	  + sources/scripts/volume from packages/rocknix). Vendored with
	  two minimal adaptations: input_sense + volume source the
	  functions library from a private path
	  (/usr/lib/panicos-input-sense/) instead of /etc/profile to avoid
	  polluting global env, and `volume` calls `wpctl set-volume`
	  instead of `pactl --set-sink-volume` since we ship pipewire's
	  wpctl rather than pulseaudio-utils.

	  Many of the function-key actions invoke helpers that don't exist
	  on PanicOS yet (rocknix-fake-suspend, brightness, mango-notify,
	  screen_switch, ledcontrol, wifictl). Those handlers fail with
	  "command not found" — relevant key combos just no-op until the
	  helpers are stubbed in. Volume + mute work today; others come
	  online as we port the rest.
```

## package/panicos-launcher-tools/Config.in
```kconfig
config BR2_PACKAGE_PANICOS_LAUNCHER_TOOLS
	bool "panicos-launcher-tools"
	depends on BR2_PACKAGE_BUSYBOX || BR2_PACKAGE_UNZIP   # for unzip
	select BR2_PACKAGE_CURL
	help
	  Scripts shown in the EmulationStation "Tools" submenu —
	  user-invoked utilities that don't belong in always-on
	  systemd-service land. Right now this is just
	  Install.PortMaster.sh, which downloads + installs PortMaster on
	  demand (avoids bundling 100MB+ of PortMaster.zip in every image).

	  Installed under /usr/share/panicos-launcher/tools/. The launcher
	  flavor's ES config registers that path as the Tools system so
	  these scripts appear automatically in ES's menu — no copy step
	  to the user's /storage/roms tree required.
```

## package/panicos-lib32/Config.in
```kconfig
config BR2_PACKAGE_PANICOS_LIB32
	bool "panicos-lib32"
	depends on BR2_aarch64
	help
	  32-bit (armhf) runtime libraries for box86.
	  Copies glibc, libstdc++, and other fundamental armhf shared libraries
	  from the host arm-linux-gnueabihf cross-compiler sysroot into
	  /usr/lib32 on the target rootfs.
	  Requires gcc-arm-linux-gnueabihf in the Docker build image.
```

## package/panicos-libglu/Config.in
```kconfig
config BR2_PACKAGE_PANICOS_LIBGLU
	bool "panicos-libglu"
	depends on BR2_PACKAGE_PANICOS_GL4ES
	help
	  OpenGL Utility Library (GLU) built against panicos-gl4es.

	  Provides libGLU.so.1 with gluPerspective, gluLookAt, tessellation,
	  NURBS, and other GLU functions.  Required by PortMaster ports that
	  call GLU APIs directly.

	  Uses panicos-gl4es as the libGL provider via a gl.pc installed to
	  the staging tree by panicos-gl4es.  Bypasses buildroot's libgl
	  virtual package (which requires X11/GLX).
```

## package/panicos-net-tools/Config.in
```kconfig
config BR2_PACKAGE_PANICOS_NET_TOOLS
	bool "panicos-net-tools"
	depends on BR2_INIT_SYSTEMD
	depends on BR2_PACKAGE_BASH
	depends on BR2_PACKAGE_IWD
	depends on BR2_PACKAGE_BLUEZ5_UTILS
	help
	  Backend scripts for the runtime network/bluetooth menus that
	  EmulationStation calls into:

	    wifictl              — wifi management (iwd backend). ES
	                           shells out to this for scan/connect/
	                           disable/list etc.
	    rocknix-bluetooth    — bluetooth pairing (bluez backend). ES
	                           shells out for live discovery, trust,
	                           connect, disconnect, remove.
	    rocknix-bluetooth-agent — agent that auto-confirms passkey
	                              prompts during pairing.
	    /etc/profile.d/001-panicos-functions — get_setting/set_setting
	                                            shell helpers the
	                                            scripts depend on.
	    /usr/config/system/configs/system.cfg — default settings
	                                            seeded onto /storage
	                                            on first boot.

	  Vendored verbatim from the ROCKNIX submodule
	  (third_party/rocknix). Keeps wifictl/bluetooth UX feature-parity
	  with ROCKNIX so users coming from those distros find the same
	  menu behaviors. The agent service starts automatically with
	  bluetooth.service.
```

## package/panicos-pht-portmaster/Config.in
```kconfig
config BR2_PACKAGE_PANICOS_PHT_PORTMASTER
	bool "panicos-pht-portmaster"
	depends on BR2_PACKAGE_PANICOS_LAUNCHER_TOOLS
	help
	  Stages the protection-enabled PanicTracker (PHT) PortMaster port
	  zip from vendor/pht.zip under
	  /usr/share/panicos-launcher/portmaster-preload/. panicos-firstboot
	  unzips it into /storage/roms/ports/ on first boot, producing a
	  PanicTracker entry in ES's Ports menu alongside Rockbox / Doom Engines.

	  Vendor the zip first by running scripts/vendor-pht.sh — that
	  invokes license-setup.sh port in PHT_REPO and stashes both
	  vendor/pht/ (for the panicos-pht /opt-style install) and
	  vendor/pht.zip (for this PortMaster-style install).

	  This is the same protection-enabled aarch64 build the panicos-pht
	  package ships at /opt/pht/ — re-using the artifact rather than
	  re-running license-setup.sh per-flavor.
```

## package/panicos-pht/Config.in
```kconfig
config BR2_PACKAGE_PANICOS_PHT
	bool "panicos-pht (ProHandheldTracker)"
	depends on BR2_aarch64
	depends on BR2_TOOLCHAIN_USES_GLIBC
	depends on BR2_INSTALL_LIBSTDCPP    # pht-aarch64 + 3 plugins link libstdc++.so.6
	select BR2_PACKAGE_SDL2
	select BR2_PACKAGE_ALSA_LIB
	help
	  ProHandheldTracker — PortMaster-flavor SDL2 audio tracker.
	  Bundles the prebuilt aarch64 binary, ~50MB of plugin DSPs, and
	  a launcher tuned for handheld use (sets SDL_AUDIODRIVER=pipewire,
	  exports SDL_GAMECONTROLLERCONFIG from the bundled gamecontrollerdb).

	  Payload comes from vendor/pht/ in the repo. Run scripts/vendor-pht.sh
	  to populate that directory from your local
	  ~/prohandheldtracker-build/dist/stage/pht. Build will fail with a
	  clear error if vendor/pht/bin/pht-aarch64 is absent.

	  Pairs with the "pht" flavor (pht autostarts at boot under chrt) or
	  can be installed in any flavor for a launch-on-demand setup.

if BR2_PACKAGE_PANICOS_PHT

config BR2_PACKAGE_PANICOS_PHT_AUTOSTART
	bool "autostart on boot (replaces tty1 getty)"
	depends on BR2_INIT_SYSTEMD
	help
	  Install panicos-pht.service into multi-user.target.wants and have
	  it Conflicts=getty@tty1.service. PHT takes the panel via KMSDRM
	  master, so when the unit starts systemd shuts down the tty1 getty
	  to avoid fbcon fighting PHT for the framebuffer.

	  On by default for the "pht" flavor. Disable if you want to launch
	  PHT manually (e.g. from SSH for debugging).

endif # BR2_PACKAGE_PANICOS_PHT
```

## package/panicos-portmaster-preload/Config.in
```kconfig
config BR2_PACKAGE_PANICOS_PORTMASTER_PRELOAD
	bool "panicos-portmaster-preload"
	depends on BR2_PACKAGE_PANICOS_LAUNCHER_TOOLS
	help
	  Stages PortMaster port .zip files (Rockbox with PodOne theme
	  pre-applied, Doom Engines + bundled shareware DOOM1.WAD +
	  Freedoom 1/2) under /usr/share/panicos-launcher/portmaster-preload/.
	  panicos-firstboot copies them into the autoinstall folder so
	  PortMaster picks them up on first launch.
```

## package/panicos-powervr-ge8300/Config.in
```kconfig
config BR2_PACKAGE_PANICOS_POWERVR_GE8300
	bool "panicos-powervr-ge8300"
	depends on BR2_aarch64
	select BR2_PACKAGE_HAS_LIBEGL
	select BR2_PACKAGE_HAS_LIBGLES
	help
	  Install the PowerVR GE8300 userspace GPU driver blobs for the
	  TrimUI Brick (Allwinner A133). Provides libEGL, libGLESv2,
	  libGLESv1_CM, libVK_IMG, pvrsrvctl, and the GPU firmware blob.

	  The kernel-side pvrsrvkm.ko driver is pre-built into the vendor
	  4.9.191 kernel — this package is only useful with KERNEL=vendor.
	  With the mainline kernel, pvrsrvkm.ko is absent and GPU init fails.

if BR2_PACKAGE_PANICOS_POWERVR_GE8300

config BR2_PACKAGE_PROVIDES_LIBEGL
	default "panicos-powervr-ge8300"

config BR2_PACKAGE_PROVIDES_LIBGLES
	default "panicos-powervr-ge8300"

endif
```

## package/panicos-quirks/Config.in
```kconfig
config BR2_PACKAGE_PANICOS_QUIRKS
	bool "panicos-quirks"
	depends on BR2_INIT_SYSTEMD
	select BR2_PACKAGE_BASH
	help
	  ROCKNIX's hardware-quirks system, vendored verbatim from
	  third_party/rocknix/projects/ROCKNIX/packages/hardware/quirks/
	  plus the autostart runner from sysutils/autostart.

	  At boot, panicos-quirks-autostart.service runs /usr/bin/autostart,
	  which walks /usr/lib/autostart/quirks/platforms/${HW_DEVICE}/ and
	  /usr/lib/autostart/quirks/devices/${QUIRK_DEVICE}/ in numeric
	  order. Each quirk script writes per-device defaults into
	  /storage/.config/profile.d/001-device_config (DEVICE_AUDIO_MIXER,
	  DEVICE_KEY_VOLUMEUP, DEVICE_HAS_FAN, DEVICE_PWM_FAN, etc.) and
	  /etc/profile.d/999-quirks-export.sh exports them so every later
	  shell sees them.

	  The vendored ROCKNIX scripts (rocknix-fake-suspend, ledcontrol,
	  brightness, fancontrol, headphone_sense, ...) consult these vars
	  to dispatch hardware-specific behavior — which is why vendoring
	  the quirks system "for free" lights up correct behavior on any
	  device ROCKNIX already supports the moment we add its DT model
	  to the platforms/ or devices/ tree.

	  Adaptations vs upstream: rocknix-autostart.service is renamed
	  panicos-quirks-autostart.service and retargeted to
	  WantedBy=multi-user.target (no rocknix.target on PanicOS); the
	  Before=emustation.service / weston.service ordering is dropped
	  (we use ES under different names and don't ship weston). HW_DEVICE
	  is set via /etc/profile.d/045-hw-device.sh by sniffing the device
	  tree compatible string instead of hardcoding it in /etc/os-release
	  the way ROCKNIX's image script does.
```

## package/panicos-rtl8852bs/Config.in
```kconfig
config BR2_PACKAGE_PANICOS_RTL8852BS
	bool "panicos-rtl8852bs"
	depends on BR2_LINUX_KERNEL
	help
	  Build the out-of-tree Realtek RTL8852BS SDIO WiFi kernel module
	  (rtl8852bs.ko) for the TrimUI Brick (Allwinner A133) mainline
	  kernel. The AW859A chip (Allwinner part number for RTL8852BS) is
	  connected via SDIO on sdc1.

	  Only needed with the mainline kernel (KERNEL=mainline). With the
	  vendor kernel (KERNEL=vendor), the SDIO WiFi driver is built into
	  the 4.9.191 kernel blob and this module is not required.

	  Firmware files (rtl8852b_fw.bin) are provided by linux-firmware
	  selected via BR2_PACKAGE_LINUX_FIRMWARE_RTL_RTW88.
```
