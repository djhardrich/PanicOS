## package/panicos-samba/Config.in
```kconfig
config BR2_PACKAGE_PANICOS_SAMBA
	bool "panicos-samba"
	select BR2_PACKAGE_SAMBA4
	depends on BR2_INIT_SYSTEMD
	help
	  Samba SMB file server for PanicOS. Shares /storage over the
	  local network for easy game and config file transfer from a PC.

	  Disabled by default — enable via the ES network settings menu
	  (Main Menu → Network Settings → Enable Samba). The toggle calls
	  `systemctl start/stop smbd` and persists via samba.enabled in
	  system.cfg.
```

## package/panicos-sc3-community-plugins/Config.in
```kconfig
config BR2_PACKAGE_PANICOS_SC3_COMMUNITY_PLUGINS
	bool "panicos-sc3-community-plugins"
	depends on BR2_PACKAGE_SUPERCOLLIDER
	help
	  Community SuperCollider UGen plugin collections for norns.
	  Builds from source against the supercollider package source tree
	  (-DSC_PATH) so plugin ABI always matches the installed scsynth.

	  Plugins included:
	    PortedPlugins, f0plugins, XPlayBuf, NasalDemons, PulsePTR,
	    TrianglePTR, CDSkip, mi-UGens, SuperBuf, IBufWr

	  Installs .so files to /usr/share/SuperCollider/Extensions/<name>/
	  (sclang extension path, discovered at sclang startup).

	  Requires: run scripts/vendor-sc-community-plugins.sh first to
	  populate vendor/sc-community-plugins/ with the plugin sources.
```

## package/panicos-splash/Config.in
```kconfig
config BR2_PACKAGE_PANICOS_SPLASH
	bool "panicos-splash"
	depends on BR2_INIT_SYSTEMD
	select BR2_PACKAGE_FBV
	help
	  Early-boot splash screen. Paints a PanicOS image to /dev/fb0 via
	  fbv before getty (minimal flavor) or PHT (pht flavor) takes over
	  the panel.

	  Boots much cleaner with `quiet` on the kernel cmdline so kernel
	  messages don't scroll over the splash. Pre-scaled to 640x480
	  (H700 + RG353P) and 1024x768 (TrimUI Brick); the launcher reads
	  /sys/class/drm/card0-*/modes at boot to pick the closest match.

	  Splash service is set up as Conflicts=getty@tty1.service and
	  Conflicts=panicos-pht.service so it auto-stops when the next
	  consumer of the panel starts — no race, no leftover process.
```

## package/panicos-sshkeys/Config.in
```kconfig
config BR2_PACKAGE_PANICOS_SSHKEYS
	bool "panicos-sshkeys"
	depends on BR2_INIT_SYSTEMD
	depends on BR2_PACKAGE_DROPBEAR
	help
	  PanicOS first-boot SSH host key generator. Runs once before
	  dropbear, generates per-device host keys into /etc/dropbear/
	  (which sits on the overlay and persists across reboots), then
	  self-disables via marker file in /storage. Ensures every
	  flashed image ends up with unique SSH host identity.
```

## package/panicos-sway/Config.in
```kconfig
config BR2_PACKAGE_PANICOS_SWAY
	bool "panicos-sway"
	depends on BR2_INIT_SYSTEMD
	depends on BR2_PACKAGE_SWAY
	help
	  Kiosk-mode Sway compositor configuration for PanicOS launcher
	  flavors. Provides:

	    /etc/sway/panicos-kiosk.conf — minimal config: hide cursor,
	      no decorations, no idle, exec the foreground app.
	    sway.service — systemd unit that brings sway up before
	      EmulationStation (or any other Wayland client).

	  Mirrors the ROCKNIX/JELOS approach: sway runs as the display
	  manager, ES connects as a Wayland client. Without sway in this
	  shape, ES on KMSDRM has visible layering jank on menus and
	  overlays — sway does the layer-shell composition that ES
	  itself doesn't.
```

## package/panicos-umtprd/Config.in
```kconfig
config BR2_PACKAGE_PANICOS_UMTPRD
	bool "panicos-umtprd"
	help
	  Lightweight USB MTP responder daemon for usbgadget file_transfer mode.
	  Exposes /storage/roms to the host PC as an MTP device when the USB
	  gadget is switched to file_transfer in the ES network settings.
```

## package/panicos-wifi-config/Config.in
```kconfig
config BR2_PACKAGE_PANICOS_WIFI_CONFIG
	bool "panicos-wifi-config"
	depends on BR2_INIT_SYSTEMD
	select BR2_PACKAGE_WPA_SUPPLICANT
	help
	  Boot service that reads wifi credentials from a user-editable
	  file on the boot vfat (/boot/wpa_supplicant.conf raw drop-in,
	  or /boot/panicos-wifi.cfg key=value) and renders them into
	  /run/wpa_supplicant.conf. Pairs with systemd-networkd for
	  DHCP on wlan0. The credentials never touch the overlay — every
	  boot re-reads from FAT, so a Notepad edit on a PC takes effect
	  on next reboot.
```
