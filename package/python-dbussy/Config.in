## package/python-dbussy/Config.in
```kconfig
config BR2_PACKAGE_PYTHON_DBUSSY
	bool "python-dbussy"
	depends on BR2_PACKAGE_PYTHON3
	depends on BR2_PACKAGE_DBUS
	help
	  Pure-Python wrapper around libdbus, plus a higher-level
	  asyncio-based helper module (ravel). Required by the
	  ROCKNIX-vendored rocknix-bluetooth-agent script that ES
	  shells out to for bluetooth pairing UX.

	  Pinned to the same SHA ROCKNIX uses (third_party/rocknix
	  has a matching dbussy package) so script ABI matches.

	  https://github.com/ldo/dbussy
```

## package/rocknix-joypad/Config.in
```kconfig
config BR2_PACKAGE_ROCKNIX_JOYPAD
	bool "rocknix-joypad (out-of-tree gamepad driver)"
	depends on BR2_LINUX_KERNEL
	help
	  ROCKNIX's out-of-tree handheld-gamepad kernel driver. Two
	  variants share the source tree:
	    * rocknix-singleadc-joypad — H700 / RK3399 (one ADC, mux'd)
	    * rocknix-joypad           — S922X / RK3588 / others
	  Both .ko files are built and installed; udev autoloads whichever
	  matches the DT compatible. Bound by the DT node
	  `rocknix-singleadc-joypad` (or `rocknix-joypad`) — already in the
	  imported H700 DTBs (see soc/allwinner-h700/mainline/linux/patches/
	  0212-...-use-rocknix-joypad-driver.patch).

	  The H700-flavor /dev/input/eventN won't appear without this — SDL2
	  + every other input-aware app will see no gamepad until the driver
	  is loaded.
```

## package/rtkit/Config.in
```kconfig
config BR2_PACKAGE_RTKIT
	bool "rtkit"
	depends on BR2_PACKAGE_DBUS
	depends on BR2_TOOLCHAIN_HAS_THREADS
	select BR2_PACKAGE_LIBCAP
	help
	  RealtimeKit — a D-Bus system service that hands out realtime
	  (SCHED_RR) scheduling priority to client processes on request,
	  with watchdog/canary safeguards. PipeWire and JACK clients use it
	  to get low-latency RT scheduling without per-user rlimit config.

	  Now maintained under the PipeWire project.
	  https://gitlab.freedesktop.org/pipewire/rtkit

comment "rtkit needs dbus and a toolchain w/ threads"
	depends on !BR2_PACKAGE_DBUS || !BR2_TOOLCHAIN_HAS_THREADS
```

## package/sc3-plugins/Config.in
```kconfig
config BR2_PACKAGE_SC3_PLUGINS
	bool "sc3-plugins"
	depends on BR2_PACKAGE_SUPERCOLLIDER
	help
	  Official SuperCollider UGen plugin collection (sc3-plugins).
	  Builds against the supercollider package source tree so plugin
	  ABI always matches the installed scsynth.

	  Installs .so files to /usr/lib/SuperCollider/plugins/ where
	  scsynth discovers them automatically at startup.

	  https://github.com/supercollider/sc3-plugins
```

## package/supercollider/Config.in
```kconfig
config BR2_PACKAGE_SUPERCOLLIDER
	bool "supercollider"
	depends on BR2_INSTALL_LIBSTDCPP
	depends on BR2_TOOLCHAIN_HAS_THREADS
	depends on BR2_USE_WCHAR
	select BR2_PACKAGE_ALSA_LIB
	select BR2_PACKAGE_BOOST
	select BR2_PACKAGE_BOOST_ATOMIC
	select BR2_PACKAGE_BOOST_CHRONO
	select BR2_PACKAGE_BOOST_FILESYSTEM
	select BR2_PACKAGE_BOOST_PROGRAM_OPTIONS
	select BR2_PACKAGE_BOOST_REGEX
	select BR2_PACKAGE_BOOST_SYSTEM
	select BR2_PACKAGE_BOOST_THREAD
	select BR2_PACKAGE_FFTW
	select BR2_PACKAGE_FFTW_SINGLE
	select BR2_PACKAGE_LIBSNDFILE
	select BR2_PACKAGE_READLINE
	help
	  SuperCollider audio synthesis platform. Headless server build:
	  installs scsynth (synthesis server) and sclang (language
	  interpreter). No Qt/X11/IDE — server + language only.

	  https://supercollider.github.io/
```

## soc/allwinner-a133/Config.in
```kconfig
config PANICOS_SOC_ALLWINNER_A133
	bool "Allwinner A133 (sun50i-a133)"
	help
	  Allwinner A133. Used by the TrimUI Brick and related devices.
	  All kernel and U-Boot components are pre-built blobs; there is
	  no mainline or vendor build-from-source path for this SoC.

if PANICOS_SOC_ALLWINNER_A133
source "$BR2_EXTERNAL_PANICOS_PATH/soc/allwinner-a133/vendor/Config.in"
endif
```

## soc/allwinner-h700/Config.in
```kconfig
config PANICOS_SOC_ALLWINNER_H700
	bool "Allwinner H700 (sun50i-h700)"
	help
	  Allwinner H700. Used by the Anbernic RG35XX family (H, Plus,
	  Pro, 2024, SP), RG28XX, RG34XX, RG40XX, and RGCubeXX.

if PANICOS_SOC_ALLWINNER_H700
source "$BR2_EXTERNAL_PANICOS_PATH/soc/allwinner-h700/mainline/Config.in"
endif
```

## soc/rockchip-rk3326/Config.in
```kconfig
config PANICOS_SOC_ROCKCHIP_RK3326
	bool "Rockchip RK3326 / PX30"
	help
	  Rockchip RK3326 (quad-core Cortex-A35, AKA PX30). Used by a wide
	  range of retro-handheld devices: Anbernic RG351M/V, OGA/OGS/OGO,
	  Powkiddy RGB10/RGB10X, GameForce Chi, MagicX XU10, and others.
	  Two U-Boot variants are supported:
	    rk3326-a — legacy hardkernel fork (OGA/OGS/RG351 family)
	    rk3326-b — mainline U-Boot v2025.10 (RGB10X/XU-Mini-M/EEClone)

if PANICOS_SOC_ROCKCHIP_RK3326
source "$BR2_EXTERNAL_PANICOS_PATH/soc/rockchip-rk3326/mainline/Config.in"
endif
```

## soc/rockchip-rk3566/Config.in
```kconfig
config PANICOS_SOC_ROCKCHIP_RK3566
	bool "Rockchip RK3566"
	help
	  Rockchip RK3566 (quad-core Cortex-A55). Used by the Anbernic
	  RG353 family (RG353P, RG353V, RG353PS, RG353VS, RG503) and
	  Powkiddy RGB30, X55, and related devices.

if PANICOS_SOC_ROCKCHIP_RK3566
source "$BR2_EXTERNAL_PANICOS_PATH/soc/rockchip-rk3566/mainline/Config.in"
endif
```
